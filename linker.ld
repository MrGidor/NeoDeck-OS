/* layout.ld is generated by build.sh from kernel/include/layout.h (KERNEL_BASE, ...) */
INCLUDE layout.ld

ENTRY(_start)

SECTIONS
{
    . = KERNEL_BASE;
    __kernel_start = .;

    .text : ALIGN(16)
    {
        KEEP(*(.text.boot))         /* _start must be the first byte */
        *(.text .text.*)
    }

    .rodata : ALIGN(16)
    {
        *(.rodata .rodata.*)
    }

    .data : ALIGN(16)
    {
        *(.data .data.*)
    }

    /* .bss must stay last: it is not part of the file and is zeroed by _start */
    .bss : ALIGN(16)
    {
        __bss_start = .;
        *(.bss .bss.*)
        *(COMMON)
        . = ALIGN(4);
        __bss_end = .;
    }
    __kernel_end = .;

    /DISCARD/ : { *(.eh_frame) *(.comment) *(.note*) }
}

ASSERT(_start == KERNEL_BASE, "_start is not at KERNEL_BASE - bootloader would jump into the wrong place")
ASSERT(__kernel_end <= PAGE_DIRECTORY_ADDRESS, "kernel image (incl. .bss and stack) overlaps the page tables")
